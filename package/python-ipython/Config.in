## package/python-ipython/Config.in
```kconfig
config BR2_PACKAGE_PYTHON_IPYTHON
	bool "python-ipython"
	help
		IPython provides a rich toolkit to help you make the most out of using Python interactively.
		
		https://pypi.python.org/pypi/ipython
```

## package/python-numpy/Config.in
```kconfig
config BR2_PACKAGE_PYTHON_NUMPY
	bool "python-numpy"
	help
		NumPy is the fundamental package for scientific computing with Python
		
		http://www.numpy.org/
```

## package/python-scipy/Config.in
```kconfig
config BR2_PACKAGE_PYTHON_SCIPY
	bool "python-scipy"
	help
		SciPy: Scientific Library for Python
			
		http://www.scipy.org/
```
